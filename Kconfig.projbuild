## Kconfig.projbuild
```kconfig
menu "AuraVision RF Bridge"
config AURA_UDP_HOST
    string "Phone IPv4 address"
    default "192.168.4.2"
config AURA_UDP_PORT
    int "Phone UDP port"
    default 8765
endmenu
```

## sdkconfig.defaults
```kconfig
CONFIG_ESP_WIFI_CSI_ENABLED=y
CONFIG_BT_ENABLED=y
CONFIG_BT_NIMBLE_ENABLED=y
CONFIG_BT_NIMBLE_ROLE_PERIPHERAL=y
CONFIG_BT_NIMBLE_GATT_SERVER=y
CONFIG_BT_NIMBLE_GAP_SERVICE=y
CONFIG_BT_NIMBLE_MAX_CONNECTIONS=1
CONFIG_FREERTOS_HZ=1000
```
